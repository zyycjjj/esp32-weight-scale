## sdkconfig.defaults
```kconfig
# WiFi配置
CONFIG_ESP_WIFI_ENABLED=y
CONFIG_ESP_WIFI_SCAN_AUTH_MODE_THRESHOLD=2
CONFIG_ESP_WIFI_SAE_ENABLED=y
CONFIG_ESP_WIFI_SOFTAP_SUPPORT=y
CONFIG_ESP_WIFI_CONNECT_AP_BY_SIGNAL=y
CONFIG_ESP_WIFI_4WAY_HANDSHAKE_TIMEOUT=y
CONFIG_ESP_WIFI_8TX_RX=y
CONFIG_ESP_WIFI_2MBPS=y
CONFIG_ESP_WIFI_NVS_ENABLED=y
CONFIG_ESP_WIFI_SOFTAP_SSID_SUPPORT=y

# WiFi自动连接配置
CONFIG_ESP_WIFI_STA_DISCONNECTED_PM_ENABLE=y
CONFIG_ESP_WIFI_STA_DISCONNECTED_PM_MODE=WIFI_PM_NONE

# TCP/IP配置
CONFIG_LWIP_TCP_KEEPALIVE=y
CONFIG_LWIP_TCP_KEEPIDLE=120
CONFIG_LWIP_TCP_KEEPINTVL=30
CONFIG_LWIP_TCP_KEEPCNT=6

# FreeRTOS配置
CONFIG_FREERTOS_HZ=1000
CONFIG_FREERTOS_TIMER_TASK_STACK_DEPTH=2048
CONFIG_FREERTOS_IDLE_TASK_STACKSIZE=2048

# NVS配置
CONFIG_NVS_ENCRYPTION=y
CONFIG_NVS_ASSERT_DEEP_SLEEP=y

# SPIFFS配置
CONFIG_SPIFFS_MAX_PARTITIONS=3
CONFIG_SPIFFS_OBJ_NAME_LEN=32
CONFIG_SPIFFS_USE_MTIME=y

# 网络配置
CONFIG_DNS_MAX_SERVERS=3
CONFIG_LWIP_DHCP_DOES_ARP_CHECK=y
CONFIG_LWIP_DHCP_MAX_RETRIES=10

# HTTP客户端配置
CONFIG_ESP_HTTP_CLIENT_ENABLE_HTTPS=y
CONFIG_ESP_HTTP_CLIENT_EVENT_ON_HEADER=y

# cJSON配置
CONFIG_JSON_ENABLE=y

# 时间配置
CONFIG_LWIP_NETIF_LOOPBACK=y
CONFIG_LWIP_NETIF_TX_SINGLE_PBUF=y
```
